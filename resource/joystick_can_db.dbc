VERSION ""

NS_ :

BS_:

BU_:

BO_ 2566873986 right_handle: 8 Vector__XXX
 SG_ y_axis_data : 24|8@1+ (1,0) [0|255] "" Vector__XXX
 SG_ x_axis_data : 8|8@1+ (1,0) [0|255] "" Vector__XXX

BO_ 2566873985 left_handle: 8 Vector__XXX
 SG_ y_axis_data : 24|8@1+ (1,0) [0|255] "" Vector__XXX
 SG_ x_axis_data : 8|8@1+ (1,0) [0|255] "" Vector__XXX

BA_DEF_  "BusType" STRING ;
BA_DEF_DEF_  "BusType" "";
BA_ "BusType" "CAN";
