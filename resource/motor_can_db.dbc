VERSION ""

NS_ :

BS_:

BU_:

BO_ 2566873972 motor_4: 8 Vector__XXX
 SG_ stop_command_status : 6|2@1+ (1,0) [0|3] "" Vector__XXX

BO_ 2566873971 motor_3: 8 Vector__XXX
 SG_ stop_command_status : 6|2@1+ (1,0) [0|3] "" Vector__XXX

BO_ 2566873970 motor_2: 8 Vector__XXX
 SG_ stop_command_status : 6|2@1+ (1,0) [0|3] "" Vector__XXX

BO_ 2566873969 motor_1: 8 Vector__XXX
 SG_ stop_command_status : 6|2@1+ (1,0) [0|3] "" Vector__XXX

BA_DEF_  "BusType" STRING ;
BA_DEF_DEF_  "BusType" "";
BA_ "BusType" "CAN";
